## buildroot-customizations/package/libkeyfinder/Config.in
```kconfig
config BR2_PACKAGE_LIBKEYFINDER
    bool "libkeyfinder"
    help
        Installs libkeyfinder, a small C++11 library for estimating the musical key of digital
        audio. It is published under the GNU General Public License (GPL) version 3 or later.
```
